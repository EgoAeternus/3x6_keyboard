// wyld_dm_right.overlay

#include "wyld_dm.dtsi"

&default_transform {
    col-offset = <7>;
};

///  PILLBUG PINS

&kscan0 {
   row-gpios
			= <&gpio0 9 (GPIO_ACTIVE_HIGH | GPIO_PULL_DOWN)>
			, <&gpio1 7 (GPIO_ACTIVE_HIGH | GPIO_PULL_DOWN)>  // 1.07
			, <&gpio1 2 (GPIO_ACTIVE_HIGH | GPIO_PULL_DOWN)>  // 1.02
			, <&gpio1 1 (GPIO_ACTIVE_HIGH | GPIO_PULL_DOWN)>  // 1.03
			, <&gpio1 6 (GPIO_ACTIVE_HIGH | GPIO_PULL_DOWN)>  // 1.04
		    , <&gpio1 4 (GPIO_ACTIVE_HIGH | GPIO_PULL_DOWN)>  // 1.04
            ;

    col-gpios
			= <&gpio0 31  GPIO_ACTIVE_HIGH>  // 0.31
			, <&gpio0 29  GPIO_ACTIVE_HIGH>  // 0.29
            , <&gpio0 2   GPIO_ACTIVE_HIGH>  // 0.02
			, <&gpio1 15  GPIO_ACTIVE_HIGH>  //  1.15
			, <&gpio1 13  GPIO_ACTIVE_HIGH>  // 1.13
			, <&gpio1 11  GPIO_ACTIVE_HIGH>  //  1.10
            , <&gpio0 10  GPIO_ACTIVE_HIGH>  // 0.10
			;
};

&right_encoder {
	status = "okay";
};


//nice_view_spi: &spi0 {
//    compatible = "nordic,nrf-spim";
//    pinctrl-0 = <&spi0_default>;
//    pinctrl-1 = <&spi0_sleep>;
//    pinctrl-names = "default", "sleep";
//    cs-gpios = <&gpio0 12 GPIO_ACTIVE_HIGH>;
//};
